; ============================================================================
; Copyright (c) 2021 Infineon Technologies AG
;               All rights reserved.
;               www.infineon.com
; ============================================================================
;
; ============================================================================
; Redistribution and use of this software only permitted to the extent
; expressly agreed with Infineon Technologies AG.
; ============================================================================

; print currently executed file name into output window
print "Executing '"+os.ppf()+"'"

system.mode.attach
;break.enable
